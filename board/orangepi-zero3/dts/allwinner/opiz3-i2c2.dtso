/dts-v1/;
/plugin/;

&{/aliases} {
	i2c2 = "/soc/i2c@5002800";
};

&pio {
	opiz3_i2c2_pins: opiz3-i2c2-pins {
		pins = "PH2", "PH3";
		function = "i2c2";
		bias-pull-up;
	};
};

&i2c2 {
	pinctrl-names = "default";
	pinctrl-0 = <&opiz3_i2c2_pins>;
	status = "okay";
};
