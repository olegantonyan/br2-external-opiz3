## Config.in
```kconfig
source "$BR2_EXTERNAL_OPIZ3_PATH/package/uwe5622/Config.in"
source "$BR2_EXTERNAL_OPIZ3_PATH/package/hciattach-opi/Config.in"
source "$BR2_EXTERNAL_OPIZ3_PATH/package/tone/Config.in"
source "$BR2_EXTERNAL_OPIZ3_PATH/package/statusd/Config.in"
```

## configs/orangepi_zero3_wifi_defconfig
```kconfig
BR2_aarch64=y
BR2_ARM_FPU_VFPV4=y
BR2_PACKAGE_HOST_LINUX_HEADERS_CUSTOM_6_12=y
BR2_GLOBAL_PATCH_DIR="board/orangepi/orangepi-zero3/patches $(BR2_EXTERNAL_OPIZ3_PATH)/board/orangepi-zero3/patches"
BR2_DOWNLOAD_FORCE_CHECK_HASHES=y
BR2_TARGET_GENERIC_ISSUE="Welcome to Orangepi Zero3"
BR2_ROOTFS_DEVICE_CREATION_DYNAMIC_MDEV=y
BR2_SYSTEM_DHCP="eth0"
BR2_ROOTFS_POST_BUILD_SCRIPT="board/orangepi/common/post-build.sh"
BR2_ROOTFS_POST_IMAGE_SCRIPT="support/scripts/genimage.sh"
BR2_ROOTFS_POST_SCRIPT_ARGS="-c $(BINARIES_DIR)/genimage.cfg"
BR2_LINUX_KERNEL=y
BR2_LINUX_KERNEL_CUSTOM_VERSION=y
BR2_LINUX_KERNEL_CUSTOM_VERSION_VALUE="6.12.6"
BR2_LINUX_KERNEL_USE_ARCH_DEFAULT_CONFIG=y
BR2_LINUX_KERNEL_DTS_SUPPORT=y
BR2_LINUX_KERNEL_INTREE_DTS_NAME="allwinner/sun50i-h618-orangepi-zero3"
BR2_LINUX_KERNEL_DTB_KEEP_DIRNAME=y
BR2_LINUX_KERNEL_INSTALL_TARGET=y
BR2_LINUX_KERNEL_NEEDS_HOST_OPENSSL=y
BR2_TARGET_ROOTFS_EXT2=y
BR2_TARGET_ROOTFS_EXT2_4=y
BR2_TARGET_ROOTFS_EXT2_SIZE="256M"
# BR2_TARGET_ROOTFS_TAR is not set
BR2_TARGET_ARM_TRUSTED_FIRMWARE=y
BR2_TARGET_ARM_TRUSTED_FIRMWARE_CUSTOM_VERSION=y
BR2_TARGET_ARM_TRUSTED_FIRMWARE_CUSTOM_VERSION_VALUE="v2.11"
BR2_TARGET_ARM_TRUSTED_FIRMWARE_PLATFORM="sun50i_h616"
BR2_TARGET_UBOOT=y
BR2_TARGET_UBOOT_BUILD_SYSTEM_KCONFIG=y
BR2_TARGET_UBOOT_CUSTOM_VERSION=y
BR2_TARGET_UBOOT_CUSTOM_VERSION_VALUE="2026.07"
BR2_TARGET_UBOOT_BOARD_DEFCONFIG="orangepi_zero3"
BR2_TARGET_UBOOT_NEEDS_DTC=y
BR2_TARGET_UBOOT_NEEDS_PYLIBFDT=y
BR2_TARGET_UBOOT_NEEDS_OPENSSL=y
BR2_TARGET_UBOOT_NEEDS_GNUTLS=y
BR2_TARGET_UBOOT_NEEDS_ATF_BL31=y
BR2_TARGET_UBOOT_SPL=y
BR2_TARGET_UBOOT_SPL_NAME="u-boot-sunxi-with-spl.bin"
BR2_TARGET_UBOOT_CUSTOM_MAKEOPTS="SCP=/dev/null"
BR2_PACKAGE_HOST_GENIMAGE=y
BR2_PACKAGE_HOST_UBOOT_TOOLS=y
BR2_TOOLCHAIN_BUILDROOT_GLIBC=y
BR2_TARGET_GENERIC_ROOT_PASSWD="root"
BR2_ROOTFS_DEVICE_TABLE="system/device_table.txt $(BR2_EXTERNAL_OPIZ3_PATH)/board/orangepi-zero3/device_table.txt"
BR2_ROOTFS_OVERLAY="$(BR2_EXTERNAL_OPIZ3_PATH)/board/orangepi-zero3/rootfs-overlay"
BR2_LINUX_KERNEL_CONFIG_FRAGMENT_FILES="$(BR2_EXTERNAL_OPIZ3_PATH)/board/orangepi-zero3/linux.fragment"
BR2_PACKAGE_UWE5622=y
BR2_PACKAGE_HCIATTACH_OPI=y
BR2_PACKAGE_WPA_SUPPLICANT=y
BR2_PACKAGE_WPA_SUPPLICANT_NL80211=y
BR2_PACKAGE_WPA_SUPPLICANT_CLI=y
BR2_PACKAGE_IW=y
BR2_PACKAGE_WIRELESS_REGDB=y
BR2_PACKAGE_BLUEZ5_UTILS=y
BR2_PACKAGE_BLUEZ5_UTILS_CLIENT=y
BR2_PACKAGE_BLUEZ5_UTILS_TOOLS=y
BR2_PACKAGE_BLUEZ5_UTILS_DEPRECATED=y
BR2_PACKAGE_DROPBEAR=y
BR2_PACKAGE_DROPBEAR_DISABLE_REVERSEDNS=y
BR2_PACKAGE_ALSA_UTILS=y
BR2_PACKAGE_ALSA_UTILS_AMIXER=y
BR2_PACKAGE_ALSA_UTILS_APLAY=y
BR2_PACKAGE_ALSA_UTILS_SPEAKER_TEST=y
BR2_PACKAGE_STRESS_NG=y
```

## package/hciattach-opi/Config.in
```kconfig
config BR2_PACKAGE_HCIATTACH_OPI
	bool "hciattach-opi"
	help
	  Orange Pi hciattach with Unisoc "sprd" (UWE5622) support,
	  taken from orangepi-build hcitools.
```

## package/statusd/Config.in
```kconfig
config BR2_PACKAGE_STATUSD
	bool "statusd"
	depends on BR2_TOOLCHAIN_HAS_THREADS # libdrm
	select BR2_PACKAGE_LIBDRM
	help
	  HDMI status screen drawn by the CPU on KMS dumb buffers.
	  Follows hotplug and resolution changes.
```

## package/tone/Config.in
```kconfig
config BR2_PACKAGE_TONE
	bool "tone"
	select BR2_PACKAGE_ALSA_LIB
	select BR2_PACKAGE_ALSA_LIB_PCM
	help
	  Continuous sine test tone, same signal on both channels,
	  played directly through ALSA (default hw:SPDIF).
```

## package/uwe5622/Config.in
```kconfig
config BR2_PACKAGE_UWE5622
	bool "uwe5622"
	depends on BR2_LINUX_KERNEL
	help
	  Unisoc UWE5622 WiFi/Bluetooth out-of-tree kernel drivers
	  (uwe5622_bsp_sdio, sprdwl_ng, sprdbt_tty), Allwinner variant.

	  https://github.com/armbian/uwe5622

comment "uwe5622 needs a Linux kernel to be built"
	depends on !BR2_LINUX_KERNEL
```
